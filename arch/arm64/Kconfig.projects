## arch/arm64/Kconfig.projects
```kconfig
config SEC_C2Q_PROJECT
	default n
	bool "Samsung C2Q Project"
	help
	  Support for Samsung C2Q Project

config MACH_C2Q_USA_SINGLE
	default n
	bool "Samsung C2Q USA SQ"
	help
	  Support for Samsung C2Q USA SQ device.

config SEC_C1Q_PROJECT
	default n
	bool "Samsung C1Q Project"
	help
	  Support for Samsung C1Q Project

config MACH_C1Q_USA_SINGLE
	default n
	bool "Samsung C1Q USA SQ"
	help
	  Support for Samsung C1Q USA SQ device.

config SEC_Z3Q_PROJECT
	default n
	bool "Samsung Z3Q Project"
	help
	  Support for Samsung Z3Q Project

config MACH_Z3Q_USA_SINGLE
	default n
	bool "Samsung Z3Q USA SQ"
	help
	  Support for Samsung Z3Q USA SQ device.

config SEC_Y2Q_PROJECT
	default n
	bool "Samsung Y2Q Project"
	help
	  Support for Samsung Y2Q Project

config MACH_Y2Q_USA_SINGLE
	default n
	bool "Samsung Y2Q USA SQ"
	help
	  Support for Samsung Y2Q USA SQ device.

config SEC_X1Q_PROJECT
	default n
	bool "Samsung X1Q Project"
	help
	  Support for Samsung X1Q Project

config MACH_X1Q_USA_SINGLE
	default n
	bool "Samsung X1Q USA SQ"
	help
	  Support for Samsung X1Q USA SQ device.

config SEC_R8Q_PROJECT
	default n
	bool "Samsung R8Q Project"
	help
	  Support for Samsung R8Q Project

config MACH_R8Q_USA_SINGLE
	default n
	bool "Samsung R8Q USA SQ"
	help
	  Support for Samsung R8Q USA SQ device.
```
